/ {
  chosen {
        zephyr,console = &usart3;
        zephyr,shell-uart = &usart3;
   };
};

&usart3 {
    pinctrl-0 = <&usart3_tx_pd8 &usart3_rx_pb11>;
    pinctrl-names = "default";
    current-speed = <115200>;
    status = "okay";
};
